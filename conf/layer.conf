## conf/layer.conf
```bitbake
# We have a conf and classes directory, add to BBPATH
BBPATH .= ":${LAYERDIR}"

# We have recipes-* directories, add to BBFILES
BBFILES += "${LAYERDIR}/recipes-*/*/*.bb \
            ${LAYERDIR}/recipes-*/*/*.bbappend"

BBFILE_COLLECTIONS += "meta-alientek"
BBFILE_PATTERN_meta-alientek = "^${LAYERDIR}/"
BBFILE_PRIORITY_meta-alientek = "10"

LAYERDEPENDS_meta-alientek = "core freescale-layer"
LAYERSERIES_COMPAT_meta-alientek = "kirkstone"
```

## conf/machine/imx6ull-alientek.conf
```bitbake
#@TYPE: Machine
#@NAME: Alientek i.MX6ULL MINI
#@DESCRIPTION: 正点原子 i.MX6ULL MINI 开发板

require conf/machine/imx6ullevk.conf

# 只覆盖差异: 用我自己的设备树
KERNEL_DEVICETREE = "imx6ull-alientek.dtb"
```
